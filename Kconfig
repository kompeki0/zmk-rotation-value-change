## Kconfig
```kconfig
config ZMK_VALUE_STORE_SIZE
    int "Value store size"
    default 8
    range 1 64
    help
      Number of integer slots available for behaviors that store adjustable values.
```

## dts/bindings/behaviours/zmk,behavior-sensor-scroll-pulse.yaml
```yaml
description: Sensor scroll pulse behavior (encoder tick -> short hold scroll)

compatible: "zmk,behavior-sensor-scroll-pulse"

properties:
  "#sensor-binding-cells":
    type: int
    required: true
    const: 0

  bindings:
    type: phandle-array
    required: true
    description: "Dummy binding list. Use <&none>."

  binding:
    type: phandle
    required: true
    description: Target behavior device (must be zmk,behavior-input-two-axis configured for wheel)

  pulse-ms:
    type: int
    required: false
    default: 30

  fast-dt-ms:
    type: int
    required: false
    default: 60

  slow-dt-ms:
    type: int
    required: false
    default: 250

  min-speed:
    type: int
    required: false
    default: 3

  max-speed:
    type: int
    required: false
    default: 18

  axis:
    type: int
    required: false
    default: 0
    description: 0=wheel(vertical), 1=hwheel(horizontal)
```

## dts/bindings/behaviours/zmk,behavior-sensor-scroll-velocity.yaml
```yaml
description: Sensor behavior - scroll amount scales with rotary tick speed

compatible: "zmk,behavior-sensor-scroll-velocity"

properties:
  "#sensor-binding-cells":
    type: int
    required: true
    const: 0

  bindings:
    type: phandle-array
    required: true
    description: "Dummy binding list. Use <&none>."

  axis:
    type: int
    required: false
    default: 0
    description: "0=vertical wheel (INPUT_REL_WHEEL), 1=horizontal wheel (INPUT_REL_HWHEEL)"

  invert:
    type: int
    required: false
    default: 0
    description: "0=normal, 1=invert direction"

  slow-amount:
    type: int
    required: false
    default: 1
    description: "Scroll amount per tick at slowest rotation (lines per tick)"

  fast-amount:
    type: int
    required: false
    default: 6
    description: "Scroll amount per tick at fastest rotation (lines per tick)"

  fast-threshold-ms:
    type: int
    required: false
    default: 20
    description: "If dt <= this, treat as fastest"

  slow-threshold-ms:
    type: int
    required: false
    default: 140
    description: "If dt >= this, treat as slowest"

  ema-alpha-permil:
    type: int
    required: false
    default: 300
    description: "EMA smoothing for dt. 0=no smoothing, 1000=use only newest. e.g. 300"
```

## dts/bindings/behaviours/zmk,behavior-sensor-value-adjust.yaml
```yaml
description: Sensor behavior to adjust an integer value by rotary detents

compatible: "zmk,behavior-sensor-value-adjust"

properties:
  "#sensor-binding-cells":
    type: int
    required: true
    const: 0

  index:
    type: int
    required: true
    description: "Value store index to modify"

  min:
    type: int
    required: false
    default: 0

  max:
    type: int
    required: false
    default: 100

  step:
    type: int
    required: false
    default: 1

  ticks-per-step:
    type: int
    required: false
    default: 1

  bindings:
    type: phandle-array
    required: true
    description: "Dummy binding list (required by keymap sensor controller). Use <&none>."
```

## dts/bindings/behaviours/zmk,behavior-value-switch.yaml
```yaml
description: Dispatch to a binding based on value_store value

compatible: "zmk,behavior-value-switch"

include: zero_param.yaml

properties:
  index:
    type: int
    required: true

  fallback:
    type: int
    required: false
    default: 0

  case-values:
    type: array
    required: true
    description: Integer values to match against value_store[index]

  bindings:
    type: phandle-array
    required: true
    description: |
      Binding list aligned by index with case-values.
      You can optionally append one extra binding as default.
      So the allowed lengths are:
      - len(bindings) == len(case-values)
      - len(bindings) == len(case-values) + 1 (last entry is default)
```
